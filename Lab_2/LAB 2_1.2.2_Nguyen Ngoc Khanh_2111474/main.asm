;
; LAB 2_1.2.2_Nguyen Ngoc Khanh.asm
;
; Created: 5/6/2023 1:42:45 PM
; 
;
; Viet chuong trinh tao song vuong co chu ki 64us su dung timer 1 o che do CTC mode, ngo ra su dung chan OC0

                   .ORG 0
		   RJMP MAIN
		   .ORG 0X40 ; DUA CHUONG TRINH RA KHOI VUNG INTERRUPTS
MAIN:  
           LDI R16, HIGH(RAMEND)
           OUT SPH, R16
	   LDI R16, LOW(RAMEND)
	   OUT SPL, R16 ; DUA STACK LEN VUNG DIA CHI CAO

	   LDI R16, 0X08
	   OUT DDRB, R16 ; PB3 OUTPUT OC0A 

	   LDI R17, 0X00 
	   STS TCCR1A, R17 ; TIMER 1 MODE CTC
	   LDI R17, 0X0A
	   STS TCCR1B, R17 ; MODE CTC CHIA 8 RUN

	   LDI R17, HIGH(32) ; VOI BO CHIA 8, MOI LAN DEM SE TON 1US
	   STS OCR1AH, R17
	   LDI R17, LOW(32) ; DE TAO SONG 64US THI THOI GIAN MUC CAO VA MUC THAP BANG 32US
	   STS OCR1AL, R17
START: 
           SBIS TIFR1, OCF1A ; DOC CO BAO BANG GIA TRI DA NAP
           RJMP START ; NEU CHUA BANG NHAU, NHAY LAI START
	   SBI TIFR1, OCF1A ; XOA CO BAO BANG
	   IN R17, PORTB
	   LDI R16, 0X08
	   EOR R17, R16 ; DAO BIT PB3
	   OUT PORTB, R17 ; XUAT RA PORTB
	   RJMP START
