;
; LAB 4_2.1_Nguyen Ngoc Khanh.asm
;
; Created: 5/7/2023 2:51:35 AM
; 
;
; viet chuong trinh dieu khien toc do dong co DC dung PWM voi tan so 1k HZ
; su dung timer 2
; dieu khien toc do tang/giam su dung 2 nut nhan, moi lan nhan nut tang/giam duty cycle 5%
; cho phep dong co chay/dung va dieu khien dong co quay thuan/nguoc bang 2 switch tren dip switch

; ket noi dong co vao kit thi nghiem
; ket noi tin hieu tu 2 switch tren dip switch vao 2 chan port cua avr
; ket noi tin hieu tu 2 nut nhan vao 2 chan port cua avr
; ket noi tin hieu tu chan OC2B ra 1 kenh do cua khoi test point, quan sat dang song
; ket noi tin hieu tu 2 chan port dieu khien chieu quay thuan/nguoc ra led don de kiem tra trang thai

; KET NOI MOTOR VOI KIT THI NGHIEM
; PB0 NOI VOI MOTOR_CTRL1
; PB1 NOI VOI MOTOR_CTRL2
; PD6 NOI VOI MOTOR ENABLE

; PA 0:1 NOI VOI SWITCH 0:1 (DIEU KHIEN TOC DO)
; PA 3:4 NOI VOI DIP SWITCH 0:1 (DIEU KHIEN CHIEU QUAY)

;-------------------------------------------------------------------------------------------------------------
 
                .DEF FLAG_REG = R18
		.EQU SW_FLG = 0
		.EQU CONT_IN = PINA

		.EQU CONT_ROTDC = PORTB ; DIEU KHIEN CHIEU QUAY DONG CO
		.EQU CONT_ROTDC_DDR = DDRB
		.EQU MOTOR_CTRL1 = 0
		.EQU MOTOR_CTRL2 = 1

		.EQU MOTOR_ENABLE = 6 ; 0C0B = PB4

		.EQU SW1 = 0 ; BUTTON UP SPEED
		.EQU SW2 = 1 ; BUTTON DOWN SPEED
		.EQU SW3 = 2 ; SWITCH SET UP CHIEU QUAY DONG CO
		.EQU SW4 = 3 ; SWITCH DUNG DONG CO

		.EQU PMIN = 5 ; DUTY CYCLE = 5% LA MIN
		.EQU PMAX = 118 ; DUTY CYCLE = 95% LA MAX
		.EQU DELTA = 6 ; THAY DOI (NHANH/CHAM) 5% DUTY CYCLE

		.ORG 0
		RJMP MAIN
		.ORG 0X40 ; DUA CHUONG TRINH RA KHOI VUNG INTERRUPTS
MAIN:
		LDI R16, HIGH(RAMEND)
		OUT SPH, R16
		LDI R16, LOW(RAMEND)
		OUT SPL, R16 ; DUA STACK LEN VUNG DIA CHI CAO

		LDI R16, (1 << MOTOR_ENABLE) 
		OUT DDRD, R16; NGO RA DIEU KHIEN TOC DO DONG CO

		LDI R16, (1 << MOTOR_CTRL1)|(1 << MOTOR_CTRL2)
		OUT CONT_ROTDC_DDR, R16 ; NGO RA DIEU KHIEN CHIEU QUAY DONG CO

		LDI R16, 0 ; PORTA LA INPUT CONTROL UP/DOWN SPEED AND ROTATION OF MORTOR DC
		OUT DDRA, R16 
		LDI R16, 0X0F ; DIEN TRO KEO LEN 
		OUT PORTA, R16
START0:
		LDI R16, 124 ; GIA TRI DAT OCR0A TAO Fo = 1KHz
		STS OCR2A, R16
		LDI R16, PMIN ; GIA TRI DAT OCR2B TAO CKNV 5%
		STS OCR2B, R16

		LDI R16, 0B00100011 ; TIMER 2 MODE FPWM7, KHONG DAO OC2A
		STS TCCR2A, R16
		LDI R16, 0B00001100 ; TIMER 2 MODE FPWM7, HE SO CHIA N = 64
		STS TCCR2B, R16
		LDI R19, DELTA ; DELTA LA SO TANG GIAM DUTY CYCLE
START:
		IN R17, CONT_IN
		ANDI R17, (1 << SW3)|(1 << SW4) ; CHE BIT SW3, SW4
		SBRC R17, SW4
		RJMP STOP_MOTOR
		SBRC R17, SW3
		RJMP REVERSE
		;DONG CO QUAY CHIEU THUAN
		SBI CONT_ROTDC, MOTOR_CTRL1
		CBI CONT_ROTDC, MOTOR_CTRL2
		RJMP CONTINUE
REVERSE:	
		CBI CONT_ROTDC, MOTOR_CTRL1
		SBI CONT_ROTDC, MOTOR_CTRL2
		RJMP CONTINUE
STOP_MOTOR:
		LDI R16, 0B00100011 ;TIMER0 MODE FPWM7, KHONG DAO OC0A
		STS TCCR2A, R16
		LDI R16, 0B00001000 ;TIMER0 MODE FPWM7, DUNG TIMER
		STS TCCR2B, R16
		SBI PORTD, MOTOR_ENABLE
		CBI CONT_ROTDC, MOTOR_CTRL1
		CBI CONT_ROTDC, MOTOR_CTRL2
		RJMP START0

CONTINUE:
		RCALL GET_SW ;DOC SW
		SBRS FLAG_REG, SW_FLG ; CO SW_FLG = 1 CO SW NHAN
		RJMP START
		CPI R17, 1 ; SW1 = UP NHAN?
		BRNE SW2_CHK ; KIEM TRA SW2
		LDS R17, OCR2B ; DOC OCR2B
		ADD R17, R19 ; R17 = R17 + DELTA
		CPI R17, PMAX ; DO RONG XUNG VUOT PMAX?
		BRCS UP_SP ; CHUA -> CAP NHAT GIA TRI MOI
		LDI R17, PMAX ; GIOI HAN GIA TRI = PMAX
UP_SP:	
		STS OCR2B, R17 ;CAP NHAT OCR2B
		RJMP START

SW2_CHK:
		CPI R17, 2 ; SW2 = DOWN NHAN?
		BRNE START
		LDS R17, OCR2B ;DOC OCR2B
		SUB R17, R19 ; R17 = R17-DELTA
		CPI R17, PMIN ; DO RONG XUNG DUOI PMIN?
		BRCC DWN_SP ; CHUA -> CAP NHAT GIA TRI MOI
		LDI R17, PMIN ; GIOI GIAN GIA TRI = PMIN
DWN_SP:
		STS OCR2B, R17 ; CAP NHAT OCR2B
		RJMP START

;------------------------------------------
;GET_SW DOC TRANG THAI SW1,SW2 CO CHONG RUNG
;TRA VE MA SW1 = 1 HOAC MA SW2 = 2 VA CO SW_FLG = 1 NEU CO SW NHAN
;TRA VE VO SW_FLG = 0 NEU KHONG CO SW NHAN
;SU DUNG R16, R17, CO SW_FLG THUOC THANH GHI FLAG_REG
;------------------------------------------
GET_SW:
		CBR FLAG_REG, (1 << SW_FLG) ; XOA CO BAO NHAN SW
BACK0:	
		LDI R16, 50
WAIT0:
		IN R17, CONT_IN
		ANDI R17, (1 << SW1)|(1 << SW2) ; CHE BIT SW1,SW2
		CPI R17, (1 << SW1)|(1 << SW2)
		BREQ EXIT_SW ; KHONG NHAN -> THOAT
		DEC R16 ; CO NHAN
		BRNE WAIT0
		PUSH R17 ; CAT MA SW
BACK1:
		LDI R16, 50
WAIT1:
		IN R17, CONT_IN
		ANDI R17, (1 << SW1)|(1 << SW2) ; CHE BIT SW1, SW2
		CPI R17, (1 << SW1)|(1 << SW2)
		BRNE BACK1 ;CHO NHA SW
		DEC R16
		BRNE WAIT1
		POP R17 ; PHUC HOI MA SW
		CPI R17, (1 << SW2) ; SW1 = 0 NHAN, SW2 = 1 KHONG NHAN
		BRNE SW2_CODE ; KHONG PHAI KIEM TRA MA SW2
		LDI R17, 1
		RJMP SET_FLG ; BAO CO NHAN SW
SW2_CODE:	
		CPI R17, (1 << SW1) ; SW2 = 0 NHAN, SW1 = 1 KHONG NHAN
		BRNE EXIT_SW ; KHONG PHAI -> THOAT
		LDI R17, 2
SET_FLG: 
		SBR FLAG_REG,(1 << SW_FLG) ; DAT CO BAO NHAN SW
EXIT_SW:
		RET
