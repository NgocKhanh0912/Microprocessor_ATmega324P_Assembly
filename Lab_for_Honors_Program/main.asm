;
; Extra_Lab_KSTN_Nguyen Ngoc Khanh_2111474.asm
;
; 
; Mot can dien tu ban mit dac san hoat dong nhu sau:

; Trai duoi 2kg gia: 10.0 USD/KG (mit non)
; Trai tu 2kg den duoi 4kg gia : 14.5 USD/KG (mit gan chin toi)
; Trai tu 4kg den duoi 6kg gia : 16.0 USD/KG (mit ngon dat chuan)
; Trai tu 6kg den duoi 10kg gia : 12.5 USD/KG (mit gia)

; Can dien tu nay moi lan chi can 1 trai va can toi da 10.24 KG

; a) Thiet ke so do phan cung tren Proteus va mo phong tren phan mem nay
;    Tham khao tren phan cung cua kit thi nghiem VXL de hien thi khoi luong va gia cua moi trai mit khi duoc can len LCD
;    khoi luong lay tu gia tri bo ADC (0 -> 1024) tuong duong voi 0 -> 10.24 kg 
;    Chu thich ro rang

; b) An phim de in ket qua thanh tien tren LCD cua can len man hinh may tinh

; c) Gia cua moi loai mit nhu tren da duoc cai co dinh trong chuong trinh
;    Hay thu viet them chuong trinh co the cai dat gia cua san pham



;---------------------------------------------------------------------------------------------------------------------------------

; DUNG CAM BIEN TRONG LUONG DANG CAU WHEATSTONE (LOAD CELL)
; LOAD CELL SE TU DONG THAY DOI BIEN TRO R KHI TRONG LUONG THAY DOI
; KHI R THAY DOI THI DIEN AP TREN Ra VA Rb THAY DOI (CHIA AP), DAN DEN VRa - VRb = Vab THAY DOI, GIA TRI ADC MODE VI SAI CUNG THAY DOI
; ADC1(+) KET NOI VOI Va, ADC0(-) KET NOI VOI Vb

; SETTING CAC THONG SO LOAD CELL VA BO ADC:

; DIEN AP CAP CHO LOAD CELL LA VCC = 5V
; CAM BIEN TRONG LUONG MAX = 10KG (MIT GIA TU 6KG DEN 10KG, KHI SO KG > 10 KG DE BAI KHONG DE CAP DEN NEN COI NHU BO QUA)
; DO NHAY TOAN TAM FS = 5 mV/V (CO THE DIEU CHINH DUOC)
; DIEN TRO MOI NHANH CUA CAM BIEN O TRANG THAI TINH = 1K OHM
; DIEN AP NGO RA TOI DA CUA CAM BIEN : Vab(max) = FS x VCC = 0.005 x 5 = 25mV
; KHI THAY DOI 1 DON VI TREN LOAD CELL (STEP = 1), GIA TRI SO KG SE THAY DOI 0.2 KG

; ADC MODE VI SAI ADC1(+), ADC0(-), VREF = AVCC = 5V, GAIN = 200, DOC GIA TRI ADCH:ADCL (R31:R30)
; VI ADCH:ADCL O MODE VI SAI CHI DAT DUOC GIA TRI CAO NHAT LA 512 NEN DE CO DUOC TRONG LUONG CHINH XAC TA PHAI x2 GIA TRI ADC


;----------------------------------------------------------------------------------------------------------------------------------
; XET CAN NANG CUA MIT DE BIET MIT THUOC LOAI NAO, VOI DON GIA BAO NHIEU

; DON GIA MIT LA CAC GIA TRI: 10.0 USD/KG, 14.5 USD/KG...
; GIA TIEN SAU CUNG LA (SO KG X DON GIA), VD: (1KG) X (10.0 USD/KG) = 10 USD

; KHI NHAN SW0 SE HIEN THI LINE 1: "AB.CD KG", LINE 2: "EF.G USD/KG" VOI AB.CD LA SO KG THUC TE, EF.G LA DON GIA THUC TE
; VIET CHUONG TRINH HIEN THI 2 DONG NAY TRONG NGAT NGOAI INT0 TAC DONG CANH XUONG (KHI SW0 DUOC NHAN)

; KHI NHAN SW1 SE HIEN THI LINE 1: "THANH TIEN", LINE 2: "HIJ.KLM" VOI HIJ.KLM LA GIA TIEN THUC TE
; VIET CHUONG TRINH HIEN THI 2 DONG NAY TRONG NGAT NGOAI INT1 TAC DONG CANH XUONG (KHI SW1 DUOC NHAN)

; KHI NHAN SW2 SE HIEN THI GIA TIEN CUOI CUNG LEN MAN HINH MAY TINH THONG QUA HERCULES: "THANH TIEN: HIJ.KLM"       
; SW2 LA NGAT NGOAI INT2 TAC DONG CANH XUONG DE DAP UNG YEU CAU XUAT RA MAN HINH MAY TINH NGAY LAP TUC

; NUT NHAN DUOC NHAN TAO RA YEU CAU NGAT NGOAI INT0 (SW0), INT1 (SW1), INT2 (SW2) TAC DONG CANH XUONG
; CAC CHUONG TRINH HIEN THI LCD, HIEN GIA TIEN LEN MAN HINH MAY TINH DEU DUOC VIET TRONG CHUONG TRINH NGAT

; LUU Y:
; 1) BAN DAU NGUOI DUNG PHAI NHAP DON GIA CUA 4 LOAI MIT, MOI LOAI NHAP 4 KI TU, VD: "12.5" THI '1', '2', '.', '5' LAN LUOT LA 4 KI TU
; 2) BAN DAU LCD KHONG HIEN THI KI TU, NEU NGUOI DUNG CAN CHUC NANG GI THI NHAN SW TUONG UNG
; 3) SAU KHI DA NHAN BAT KI SW NAO, NEU CO SU THAY DOI SO KG TREN LOAD CELL (HAY GIA TRI ADC) THI PHAI NHAN LAI SW DE CAP NHAT GIA TRI MOI



;-------------------------------------------------------------------------------------------------------------------------------

; GIAI THUAT NHU SAU:

; BUOC 1: 
;         DOC GIA TRI SO KG THONG QUA BO ADC: SO KG = (ADC X 2):100, ADC MAX O MODE VI SAI LA 512 NEN PHAI x2
;         VIET CHUONG TRINH CON CHUYEN GIA TRI (ADC X 2) THANH SO BCD 4 DIGIT
;         SAU DO CHUYEN LAN LUOT TUNG DIGIT CUA SO BCD THANH MA ASCII BANG CACH DUNG LENH ORI DIGIT VOI 0X30
;         SO KG = (ADC X 2):100 NEN TA SE DAT DAU CHAM THAP PHAN SAO CHO CO 2 SO THAP PHAN SAU DAU CHAM
;
;     VD: GIA TRI ADC = 325
;         (ADC X 2) = 0650
;         SO KG = (ADC X 2):100 = 06.50 KG
;         TACH (ADC X 2) THANH SO BCD 4 DIGIT : 0 6 5 0
;         TA SE DAT DAU CHAM THAP PHAN VAO GIA TRI ADC SAO CHO CO 2 SO THAP PHAN SAU DAU CHAM: 0 6 . 5 0
;         VAY TA SE THU DUOC SO KG CHINH XAC O THUC TE, IN RA MAN HINH LCD O DONG 1: "06.50 KG"

; BUOC 2: 
;         NHAP DON GIA CUA TUNG LOAI MIT TREN HERCULES TRUYEN XUONG KIT THI NGHIEM, LUU VAO DIA CHI SRAM BAT DAU TU 0X260 DEN 0X26F (CAU C)
;         DON GIA CUA TUNG LOAI MIT GOM 4 KI TU, TRONG DO CO 3 KI TU BCD CUA DON GIA VA 1 DAU CHAM THAP PHAN
;         KHI XUAT HIEN YEU CAU NHAP DON GIA, TA CAN NHAP DUNG 4 KI TU, VD: "12.5", GOM 4 KI TU '1', '2', '.', '5'
;         VIET CHUONG TRINH CON TINH (DON GIA THUC TE X10) LUU VAO THANH GHI DON_GIA (TUONG UNG VOI 4 LOAI MIT)
;
;     VD: NHAP HERCULES DON GIA CUA MIT GIA: "12.5", GOM 4 KI TU '1', '2', '.', '5'
;         CHUONG TRINH CON TINH (DON GIA THUC TE X10), LUU VAO THANH GHI DON_GIA SE THUC HIEN NHIEM VU NHU SAU:
;         1x100 + 2x10 + 5 = 125 -> THANH GHI DON_GIA

;         TA LAY DON GIA MOI KG MIT CUA TUNG LOAI MIT x10 DE BAO TOAN 1 SO THAP PHAN SAU DAU CHAM (LUU VAO THANH GHI DON_GIA)
;         VIET CHUONG TRINH CON TACH DON_GIA THANH SO BCD 3 DIGIT
;         SAU DO CHUYEN LAN LUOT TUNG DIGIT CUA SO BCD THANH MA ASCII BANG CACH DUNG LENH ORI DIGIT VOI 0X30
;         DON GIA THUC TE = (DON_GIA):10 NEN TA SE DAT DAU CHAM THAP PHAN SAO CHO CO 1 SO THAP PHAN SAU DAU CHAM
;
;     VD: DON GIA THUC TE = 12.5 USD
;         DON GIA THUC TE X 10 = 125 = DON_GIA
;         TACH THANH SO BCD 3 DIGIT: 1 2 5
;         VAY TA SE DAT DAU CHAM THAP PHAN VAO GIA TRI (DON GIA THUC TE X 10) SAO CHO CO 1 SO THAP PHAN SAU DAU CHAM: 1 2 . 5
;         VAY TA SE THU DUOC DON GIA CHINH XAC O THUC TE, IN RA MAN HINH LCD O DONG 2: "12.5 USD/KG"
        
; BUOC 3: 
;         TINH GIA TIEN NHU SAU:
;         
;         TA LAY (DON_GIA) X (ADC x 2), KET QUA LUU TRONG 3 THANH GHI GIA_TIEN(HIGH:MIDDLE:LOW)
;         GIA TRI NAM TRONG THANH GHI GIA_TIEN = (DON_GIA) X (ADC x 2) = (DON GIA THUC TE x10) X (SO KG x100) = (DON GIA THUC TE) X (SO KG) X 1000
;                                              = GIA TIEN THUC TE x1000
;         GIA TRI CHUA TRONG 3 THANH GHI GIA_TIEN(HIGH:MIDDLE:LOW) LA SO 24 BIT, SO BCD 6 DIGIT
;
;         VIET CHUONG TRINH CON TACH GIA_TIEN THANH SO BCD 6 DIGIT
;         SAU DO CHUYEN LAN LUOT TUNG DIGIT CUA SO BCD THANH MA ASCII BANG CACH DUNG LENH ORI DIGIT VOI 0X30
;         GIA TIEN THUC TE = (GIA_TIEN : 1000) NEN TA SE DAT DAU CHAM THAP PHAN SAO CHO CO 3 SO THAP PHAN SAU DAU CHAM
;
;     VD: 
;         ADC x 2 = 500
;         DON GIA = 16.0 USD/KG -> THANH GHI DON_GIA = 16.0 x 10 = 160
;         GIA_TIEN = (ADC x 2) X (DON_GIA) = 500 x 160 = 080000
;
;         TACH THANH SO BCD 5 DIGIT: 8 0 0 0 0
;         DAT DAU CHAM THAP PHAN VAO GIA TRI GIA CUOI CUNG SAO CHO CO 3 SO THAP PHAN SAU DAU CHAM, TA SE THU DUOC GIA TIEN CHINH XAC O THUC TE:
;         8 0 . 0 0 0
;         NEU NUT NHAN SW2 DUOC NHAN, IN RA MAN HINH MAY TINH TREN HERCULES: "THANH TIEN: 080.000 USD"
;          

;----------------------------------------------------------------------------------------------------------------------------------------------------
; RX VA TX CUA RS232 KET NOI VOI RXD0 (PD0) VA TXD0 (PD1)
; KET NOI 2 DAU CUA LOAD CELL VAO ADC0(-) VA ADC1(+)
; SU DUNG ADC VI SAI ADC1/0 MODE TU KICH, VREF = AREF, GAIN = 200, HIEU CHINH PHAI

; DELAY BANG TIMER 1 MODE CTC NGO 1A

; PORTC KET NOI VOI LCD
; PC0 = RS, PC1 = RW, PC2 = E, PC[4:7] = D[4:7]

; PD2 NOI VOI SWITCH 0, BAM SWITCH 0 DE HIEN SO KG VA DON GIA LEN LCD
; PD3 NOI VOI SWITCH 1, BAM SWITCH 1 DE HIEN GIA TIEN LEN LCD
; PB3 NOI VOI SWITCH 2, BAM SWITCH 2 DE HIEN "THANH TIEN: HIJ.KLM" LEN MAN HINH MAY TINH THONG QUA HERCULES
; TRONG DO HIJ.KLM LA GIA TIEN THUC TE
; NUT NHAN DUOC NHAN TAO RA YEU CAU NGAT NGOAI INT0 (SW0), INT1 (SW1), INT2 (SW2) TAC DONG CANH XUONG

;-------------------------------------------------------------------------------------------------------------------------------------------------------


			.EQU USD_PER_KG_ADR = 0X200 ; DIA CHI SRAM CHUA DONG CHU: "EF.G USD/KG" VA KI TU 0X00 (KET THUC)
			.EQU KG_ADR = 0X20C ; DIA CHI SRAM CHUA DONG CHU: "AB.CD KG" VA KI TU 0X0D (XUONG DONG)
			.EQU LCD_END_ADR = 0X215
			; DIA CHI SRAM TU 0X214 DEN 0X20C SE LUU "AB.CD KG" VA KI TU 0X0D (XUONG DONG) VOI AB.CD LA SO KG DOC DUOC TU LOAD CELL VA BO ADC
			; DIA CHI SRAM TU 0X20B DEN 0X200 SE LUU "EF.G USD/KG" VA KI TU 0X00 (KET THUC) VOI EF.G LA DON GIA CUA TUNG LOAI MIT
			; VIET CHUONG TRINH LCD DE DOC 0X0D SE CHUYEN TU DONG 1 XUONG DONG 2, DOC 0X00 SE KET THUC
			; VIET CHUONG TRINH DOC VA HIEN THI TUNG KI TU TU 0X214 DEN 0X200 RA 2 DONG LCD

			.EQU PAY_ADR = 0X240
			; DIA CHI SRAM BAT DAU TU PAY_ADR (0X240) DEN 0X252 LUU CAC KI TU ASCII, DAU CHAM THAP PHAN VA CAC SO BCD CUA GIA TIEN
			; TU DIA CHI 0X252 DEN 0X240 LUU: "THANH TIEN", 0X0D, "HIJ.KLM USD", 0X00
			; VOI HIJ.KLM LA GIA TIEN THUC TE

			.EQU NHAP_DON_GIA_ADR = 0X260 ; DIA CHI SRAM CHUA MA BCD CAC SO CUA DON GIA DUOC NHAP TU HERCULES (CAU C)
			; TU DIA CHI 0X260 DEN 0X263 LUU 3 SO BCD CUA GIA MIT GIA VA 1 KI TU LA DAU CHAM THAP PHAN
			; TU DIA CHI 0X264 DEN 0X267 LUU 3 SO BCD CUA GIA MIT NGON VA 1 KI TU LA DAU CHAM THAP PHAN
			; TU DIA CHI 0X268 DEN 0X26B LUU 3 SO BCD CUA GIA MIT GAN CHIN VA 1 KI TU LA DAU CHAM THAP PHAN
			; TU DIA CHI 0X26C DEN 0X26F LUU 3 SO BCD CUA GIA MIT NON VA 1 KI TU LA DAU CHAM THAP PHAN

			.DEF DON_GIA = R18 ; THANH GHI CHUA GIA TRI (DON GIA THUC TE x 10), X10 DE BAO TOAN 1 SO THAP PHAN SAU DAU CHAM

			.DEF DATA_TRANS = R19 ; THANH GHI CHUA NOI DUNG GUI LEN HERCULES
			; DATA_REC = R28

			.DEF GIA_TIEN_LOW = R23
			.DEF GIA_TIEN_MIDDLE = R24 ; R25:R24:R23 CHUA KET QUA GIA_TIEN
			.DEF GIA_TIEN_HIGH = R25 ; GIA_TIEN LA SO 24 BIT, LA SO BCD 6 DIGIT

			; GIA_TIEN = (DON_GIA) X (ADC x 2) = (DON GIA THUC TE x10) X (SO KG x100) = (DON GIA THUC TE) X (SO KG) X 1000
			; = GIA TIEN THUC TE x1000

			; (DON_GIA X 10), X10 DE BAO TOAN 1 SO THAP PHAN SAU DAU CHAM

			; ADC_LOW = R30 : THANH GHI CHUA GIA TRI CUA ADCL
			; ADC_HIGH = R31 : THANH GHI CHUA GIA TRI CUA ADCH

			.EQU LCD = PORTC
			.EQU LCD_DR = DDRC
			.EQU RS = 0
			.EQU RW = 1
			.EQU E = 2

			.ORG 0
			RJMP START
			.ORG 0X02 ; NGAT NGOAI INT0 (SW0) (PD2)
			RJMP INT0_ISR
			.ORG 0X04 ; NGAT NGOAI INT1 (SW1) (PD3)
			RJMP INT1_ISR
			.ORG 0X06 ; NGAT NGOAI INT2 (SW2) (PB2)
			RJMP INT2_ISR
			.ORG 0X40 ; DUA CHUONG TRINH THOAT KHOI VUNG INTERRUPTS
START:
			LDI R16, HIGH(RAMEND)
			OUT SPH, R16
			LDI R16, LOW(RAMEND) ; DUA STACK LEN VUNG DIA CHI CAO NHAT
			OUT SPL, R16

			CBI DDRD, 2 ; PD2 LA INPUT (SW0)
			CBI DDRD, 3 ; PD3 LA INPUT (SW1)
			CBI DDRB, 2 ; PB2 LA INPUT (SW2)

			SBI PORTD, 2 ; DIEN TRO KEO LEN PD2
			SBI PORTD, 3 ; DIEN TRO KEO LEN PD3
			SBI PORTB, 2 ; DIEN TRO KEO LEN PB2

			SEI ; CHO PHEP NGAT TOAN CUC

			LDI R16, (1 << ISC01)|(1 << ISC11)|(1 << ISC21) ; INT0, INT1, INT2 TAC DONG CANH XUONG
			STS EICRA, R16

			SBI EIMSK, INT0 ; CHO PHEP NGAT NGOAI INT0
			SBI EIMSK, INT1 ; CHO PHEP NGAT NGOAI INT1
			SBI EIMSK, INT2 ; CHO PHEP NGAT NGOAI INT2

			; SETTING_LCD:
			LDI R16, 0XFF
			OUT LCD_DR, R16 ; PORTC LA OUTPORT RA LCD
			LDI R16, 0X00
			OUT LCD, R16 ; GIA TRI BAN DAU PORTC = 0

			LDI R16, 250
			RCALL DELAY_128US ; CTC DELAY 128US X R16 = 32MS
			LDI R16, 250
			RCALL DELAY_128US ; CTC DELAY 128US X R16 = 32MS

			CBI LCD, RS ; RS = 0 GHI LENH
			LDI R17, 0X30 ; MA LENH 30 LAN 1
			RCALL OUT_LCD4
			LDI R16, 42
			RCALL DELAY_128US ; DELAY 5.376MS

			CBI LCD, RS ; RS = 0 GHI LENH
			LDI R17, 0X30 ; MA LENH 30 LAN 2
			RCALL OUT_LCD4
			LDI R16, 2
			RCALL DELAY_128US ; DELAY 256US

			CBI LCD, RS ; RS = 0 GHI LENH
			LDI R17, 0X30 ; MA LENH 30 LAN 3
			RCALL OUT_LCD4
			LDI R16, 2
			RCALL DELAY_128US ; DELAY 256US

			CBI LCD, RS ; RS = 0 GHI LENH
			LDI R17, 0X20 ; MA LENH 20
			RCALL OUT_LCD4

			LDI R18, 0X28 ; FUNCTION SET 2 DONG FONT 5X8 MODE 4 BIT
			LDI R19, 0X01 ; CLEAR DISPLAY
			LDI R20, 0X0C ; DISPLAY ON, CON TRO OFF
			LDI R21, 0X06 ; ENTRY MODE SET DICH PHAI CON TRO, DDRAM TANG 1 DIA CHI
			RCALL INIT_LCD4 ; CTC KHOI DONG LCD 4 BIT

			; SETTING_USART:
			RCALL USART_INIT ; KHOI DONG USART

			; CAI DAT DON GIA (CAU C)
DON_GIA_MIT_GIA:
; 1 TRONG 4 DOAN CHUONG TRINH NHAP DON GIA THUC TE CUA TUNG LOAI MIT
; HIEN THI DONG CHU: "DON GIA MIT GIA: " DE MOI NGUOI DUNG NHAP DON GIA CUA MIT GIA
; SAU DO TA NHAP DUNG 4 KI TU LA DON GIA THUC TE CUA MIT GIA
; VD: "12.5", GOM 4 KI TU '1', '2', '.', '5'

HIEN_THI_1:
			; HIEN THI DONG CHU: "DON GIA MIT GIA: "

			LDI DATA_TRANS, 'D' ; LAY MA ASCII CUA CHU D
			RCALL USART_TRANS ; TRUYEN LEN HERCULES

			LDI DATA_TRANS, 'O' ; LAY MA ASCII CUA CHU O
			RCALL USART_TRANS ; TRUYEN LEN HERCULES

			LDI DATA_TRANS, 'N' ; LAY MA ASCII CUA CHU N
			RCALL USART_TRANS ; TRUYEN LEN HERCULES

			LDI DATA_TRANS, 0X20 ; LAY MA ASCII CUA KI TU KHOANG TRANG
			RCALL USART_TRANS ; TRUYEN LEN HERCULES

			LDI DATA_TRANS, 'G' ; LAY MA ASCII CUA CHU G
			RCALL USART_TRANS ; TRUYEN LEN HERCULES

			LDI DATA_TRANS, 'I' ; LAY MA ASCII CUA CHU I
			RCALL USART_TRANS ; TRUYEN LEN HERCULES

			LDI DATA_TRANS, 'A' ; LAY MA ASCII CUA CHU A
			RCALL USART_TRANS ; TRUYEN LEN HERCULES

			LDI DATA_TRANS, 0X20 ; LAY MA ASCII CUA KI TU KHOANG TRANG
			RCALL USART_TRANS ; TRUYEN LEN HERCULES

			LDI DATA_TRANS, 'M' ; LAY MA ASCII CUA CHU M
			RCALL USART_TRANS ; TRUYEN LEN HERCULES

			LDI DATA_TRANS, 'I' ; LAY MA ASCII CUA CHU I
			RCALL USART_TRANS ; TRUYEN LEN HERCULES

			LDI DATA_TRANS, 'T' ; LAY MA ASCII CUA CHU T
			RCALL USART_TRANS ; TRUYEN LEN HERCULES

			LDI DATA_TRANS, 0X20 ; LAY MA ASCII CUA KI TU KHOANG TRANG
			RCALL USART_TRANS ; TRUYEN LEN HERCULES

			LDI DATA_TRANS, 'G' ; LAY MA ASCII CUA CHU G
			RCALL USART_TRANS ; TRUYEN LEN HERCULES

			LDI DATA_TRANS, 'I' ; LAY MA ASCII CUA CHU I
			RCALL USART_TRANS ; TRUYEN LEN HERCULES

			LDI DATA_TRANS, 'A' ; LAY MA ASCII CUA CHU A
			RCALL USART_TRANS ; TRUYEN LEN HERCULES

			LDI DATA_TRANS, ':' ; LAY MA ASCII CUA KI TU ':'
			RCALL USART_TRANS ; TRUYEN LEN HERCULES

			LDI DATA_TRANS, 0X20 ; LAY MA ASCII CUA KI TU KHOANG TRANG
			RCALL USART_TRANS ; TRUYEN LEN HERCULES

			LDI XH, HIGH(NHAP_DON_GIA_ADR) ; X TRO VAO DIA CHI SRAM 0X260 LUU DON GIA MIT GIA
			LDI XL, LOW(NHAP_DON_GIA_ADR)

			LDI R16, 4 ; THANH GHI DEM, DEM DU 4 KI TU CUA DON GIA SE DUOC LUU VAO SRAM BAT DAU TU 0X260
NHAP_DON_GIA_1:
			RCALL USART_REC ; LAY VE MA ASCII CUA 4 KI TU CUA DON GIA THUC TE
			ANDI R28, 0X0F ; CHUYEN MA ASCII THANH BCD (VD: MA ASCII LA 0X32, ANDI DE XOA 4 BIT CAO, TRO THANH 0X02 LA SO 2 (BCD))
			ST X+, R28 ; LUU VAO DIA CHI SRAM
			DEC R16 ; GIAM THANH GHI DEM DI 1 DON VI
			BRNE NHAP_DON_GIA_1 ; QUAY LAI NEU CHUA NHAP DU 4 KI TU

			LDI DATA_TRANS, 0X0D ; LAY MA ASCII CUA KI TU XUONG DONG
			RCALL USART_TRANS ; TRUYEN LEN HERCULES


DON_GIA_MIT_NGON:
; 1 TRONG 4 DOAN CHUONG TRINH NHAP DON GIA THUC TE CUA TUNG LOAI MIT
; HIEN THI DONG CHU: "DON GIA MIT NGON: " DE MOI NGUOI DUNG NHAP DON GIA CUA MIT NGON
; SAU DO TA NHAP DUNG 4 KI TU LA DON GIA THUC TE CUA MIT NGON
; VD: "12.5", GOM 4 KI TU '1', '2', '.', '5'

HIEN_THI_2:
			; HIEN THI DONG CHU: "DON GIA MIT NGON: "

			LDI DATA_TRANS, 'D' ; LAY MA ASCII CUA CHU D
			RCALL USART_TRANS ; TRUYEN LEN HERCULES

			LDI DATA_TRANS, 'O' ; LAY MA ASCII CUA CHU O
			RCALL USART_TRANS ; TRUYEN LEN HERCULES

			LDI DATA_TRANS, 'N' ; LAY MA ASCII CUA CHU N
			RCALL USART_TRANS ; TRUYEN LEN HERCULES

			LDI DATA_TRANS, 0X20 ; LAY MA ASCII CUA KI TU KHOANG TRANG
			RCALL USART_TRANS ; TRUYEN LEN HERCULES

			LDI DATA_TRANS, 'G' ; LAY MA ASCII CUA CHU G
			RCALL USART_TRANS ; TRUYEN LEN HERCULES

			LDI DATA_TRANS, 'I' ; LAY MA ASCII CUA CHU I
			RCALL USART_TRANS ; TRUYEN LEN HERCULES

			LDI DATA_TRANS, 'A' ; LAY MA ASCII CUA CHU A
			RCALL USART_TRANS ; TRUYEN LEN HERCULES

			LDI DATA_TRANS, 0X20 ; LAY MA ASCII CUA KI TU KHOANG TRANG
			RCALL USART_TRANS ; TRUYEN LEN HERCULES

			LDI DATA_TRANS, 'M' ; LAY MA ASCII CUA CHU M
			RCALL USART_TRANS ; TRUYEN LEN HERCULES

			LDI DATA_TRANS, 'I' ; LAY MA ASCII CUA CHU I
			RCALL USART_TRANS ; TRUYEN LEN HERCULES

			LDI DATA_TRANS, 'T' ; LAY MA ASCII CUA CHU T
			RCALL USART_TRANS ; TRUYEN LEN HERCULES

			LDI DATA_TRANS, 0X20 ; LAY MA ASCII CUA KI TU KHOANG TRANG
			RCALL USART_TRANS ; TRUYEN LEN HERCULES

			LDI DATA_TRANS, 'N' ; LAY MA ASCII CUA CHU N
			RCALL USART_TRANS ; TRUYEN LEN HERCULES

			LDI DATA_TRANS, 'G' ; LAY MA ASCII CUA CHU G
			RCALL USART_TRANS ; TRUYEN LEN HERCULES

			LDI DATA_TRANS, 'O' ; LAY MA ASCII CUA CHU O
			RCALL USART_TRANS ; TRUYEN LEN HERCULES

			LDI DATA_TRANS, 'N' ; LAY MA ASCII CUA CHU N
			RCALL USART_TRANS ; TRUYEN LEN HERCULES

			LDI DATA_TRANS, ':' ; LAY MA ASCII CUA KI TU ':'
			RCALL USART_TRANS ; TRUYEN LEN HERCULES

			LDI DATA_TRANS, 0X20 ; LAY MA ASCII CUA KI TU KHOANG TRANG
			RCALL USART_TRANS ; TRUYEN LEN HERCULES

			LDI XH, HIGH(NHAP_DON_GIA_ADR + 4) ; X TRO VAO DIA CHI SRAM 0X264 LUU DON GIA MIT NGON
			LDI XL, LOW(NHAP_DON_GIA_ADR + 4)

			LDI R16, 4 ; THANH GHI DEM, DEM DU 4 KI TU CUA DON GIA SE DUOC LUU VAO SRAM BAT DAU TU 0X264
NHAP_DON_GIA_2:
			RCALL USART_REC ; LAY VE MA ASCII CUA 4 KI TU CUA DON GIA THUC TE
			ANDI R28, 0X0F ; CHUYEN MA ASCII THANH BCD (VD: MA ASCII LA 0X32, ANDI DE XOA 4 BIT CAO, TRO THANH 0X02 LA SO 2 (BCD))
			ST X+, R28 ; LUU VAO DIA CHI SRAM
			DEC R16 ; GIAM THANH GHI DEM DI 1 DON VI
			BRNE NHAP_DON_GIA_2 ; QUAY LAI NEU CHUA NHAP DU 4 KI TU

			LDI DATA_TRANS, 0X0D ; LAY MA ASCII CUA KI TU XUONG DONG
			RCALL USART_TRANS ; TRUYEN LEN HERCULES

DON_GIA_MIT_GAN_CHIN:
; 1 TRONG 4 DOAN CHUONG TRINH NHAP DON GIA THUC TE CUA TUNG LOAI MIT
; HIEN THI DONG CHU: "DON GIA MIT GAN CHIN: " DE MOI NGUOI DUNG NHAP DON GIA CUA MIT GAN CHIN
; SAU DO TA NHAP DUNG 4 KI TU LA DON GIA THUC TE CUA MIT GAN CHIN
; VD: "12.5", GOM 4 KI TU '1', '2', '.', '5'

HIEN_THI_3:
			; HIEN THI DONG CHU: "DON GIA MIT GAN CHIN: "

			LDI DATA_TRANS, 'D' ; LAY MA ASCII CUA CHU D
			RCALL USART_TRANS ; TRUYEN LEN HERCULES

			LDI DATA_TRANS, 'O' ; LAY MA ASCII CUA CHU O
			RCALL USART_TRANS ; TRUYEN LEN HERCULES

			LDI DATA_TRANS, 'N' ; LAY MA ASCII CUA CHU N
			RCALL USART_TRANS ; TRUYEN LEN HERCULES

			LDI DATA_TRANS, 0X20 ; LAY MA ASCII CUA KI TU KHOANG TRANG
			RCALL USART_TRANS ; TRUYEN LEN HERCULES

			LDI DATA_TRANS, 'G' ; LAY MA ASCII CUA CHU G
			RCALL USART_TRANS ; TRUYEN LEN HERCULES

			LDI DATA_TRANS, 'I' ; LAY MA ASCII CUA CHU I
			RCALL USART_TRANS ; TRUYEN LEN HERCULES

			LDI DATA_TRANS, 'A' ; LAY MA ASCII CUA CHU A
			RCALL USART_TRANS ; TRUYEN LEN HERCULES

			LDI DATA_TRANS, 0X20 ; LAY MA ASCII CUA KI TU KHOANG TRANG
			RCALL USART_TRANS ; TRUYEN LEN HERCULES

			LDI DATA_TRANS, 'M' ; LAY MA ASCII CUA CHU M
			RCALL USART_TRANS ; TRUYEN LEN HERCULES

			LDI DATA_TRANS, 'I' ; LAY MA ASCII CUA CHU I
			RCALL USART_TRANS ; TRUYEN LEN HERCULES

			LDI DATA_TRANS, 'T' ; LAY MA ASCII CUA CHU T
			RCALL USART_TRANS ; TRUYEN LEN HERCULES

			LDI DATA_TRANS, 0X20 ; LAY MA ASCII CUA KI TU KHOANG TRANG
			RCALL USART_TRANS ; TRUYEN LEN HERCULES

			LDI DATA_TRANS, 'G' ; LAY MA ASCII CUA CHU G
			RCALL USART_TRANS ; TRUYEN LEN HERCULES

			LDI DATA_TRANS, 'A' ; LAY MA ASCII CUA CHU A
			RCALL USART_TRANS ; TRUYEN LEN HERCULES

			LDI DATA_TRANS, 'N' ; LAY MA ASCII CUA CHU N
			RCALL USART_TRANS ; TRUYEN LEN HERCULES

			LDI DATA_TRANS, 0X20 ; LAY MA ASCII CUA KI TU KHOANG TRANG
			RCALL USART_TRANS ; TRUYEN LEN HERCULES

			LDI DATA_TRANS, 'C' ; LAY MA ASCII CUA CHU C
			RCALL USART_TRANS ; TRUYEN LEN HERCULES

			LDI DATA_TRANS, 'H' ; LAY MA ASCII CUA CHU H
			RCALL USART_TRANS ; TRUYEN LEN HERCULES

			LDI DATA_TRANS, 'I' ; LAY MA ASCII CUA CHU I
			RCALL USART_TRANS ; TRUYEN LEN HERCULES

			LDI DATA_TRANS, 'N' ; LAY MA ASCII CUA CHU N
			RCALL USART_TRANS ; TRUYEN LEN HERCULES

			LDI DATA_TRANS, ':' ; LAY MA ASCII CUA KI TU ':'
			RCALL USART_TRANS ; TRUYEN LEN HERCULES

			LDI DATA_TRANS, 0X20 ; LAY MA ASCII CUA KI TU KHOANG TRANG
			RCALL USART_TRANS ; TRUYEN LEN HERCULES

			LDI XH, HIGH(NHAP_DON_GIA_ADR + 8) ; X TRO VAO DIA CHI SRAM 0X268 LUU DON GIA MIT GAN CHIN
			LDI XL, LOW(NHAP_DON_GIA_ADR + 8)

			LDI R16, 4 ; THANH GHI DEM, DEM DU 4 KI TU CUA DON GIA SE DUOC LUU VAO SRAM BAT DAU TU 0X260
NHAP_DON_GIA_3:
			RCALL USART_REC ; LAY VE MA ASCII CUA 4 KI TU CUA DON GIA THUC TE
			ANDI R28, 0X0F ; CHUYEN MA ASCII THANH BCD (VD: MA ASCII LA 0X32, ANDI DE XOA 4 BIT CAO, TRO THANH 0X02 LA SO 2 (BCD))
			ST X+, R28 ; LUU VAO DIA CHI SRAM
			DEC R16 ; GIAM THANH GHI DEM DI 1 DON VI
			BRNE NHAP_DON_GIA_3 ; QUAY LAI NEU CHUA NHAP DU 4 KI TU

			LDI DATA_TRANS, 0X0D ; LAY MA ASCII CUA KI TU XUONG DONG
			RCALL USART_TRANS ; TRUYEN LEN HERCULES


DON_GIA_MIT_NON:
; 1 TRONG 4 DOAN CHUONG TRINH NHAP DON GIA THUC TE CUA TUNG LOAI MIT
; HIEN THI DONG CHU: "DON GIA MIT NON: " DE MOI NGUOI DUNG NHAP DON GIA CUA MIT NON
; SAU DO TA NHAP DUNG 4 KI TU LA DON GIA THUC TE CUA MIT NON
; VD: "12.5", GOM 4 KI TU '1', '2', '.', '5'

HIEN_THI_4:
			; HIEN THI DONG CHU: "DON GIA MIT NON: "

			LDI DATA_TRANS, 'D' ; LAY MA ASCII CUA CHU D
			RCALL USART_TRANS ; TRUYEN LEN HERCULES

			LDI DATA_TRANS, 'O' ; LAY MA ASCII CUA CHU O
			RCALL USART_TRANS ; TRUYEN LEN HERCULES

			LDI DATA_TRANS, 'N' ; LAY MA ASCII CUA CHU N
			RCALL USART_TRANS ; TRUYEN LEN HERCULES

			LDI DATA_TRANS, 0X20 ; LAY MA ASCII CUA KI TU KHOANG TRANG
			RCALL USART_TRANS ; TRUYEN LEN HERCULES

			LDI DATA_TRANS, 'G' ; LAY MA ASCII CUA CHU G
			RCALL USART_TRANS ; TRUYEN LEN HERCULES

			LDI DATA_TRANS, 'I' ; LAY MA ASCII CUA CHU I
			RCALL USART_TRANS ; TRUYEN LEN HERCULES

			LDI DATA_TRANS, 'A' ; LAY MA ASCII CUA CHU A
			RCALL USART_TRANS ; TRUYEN LEN HERCULES

			LDI DATA_TRANS, 0X20 ; LAY MA ASCII CUA KI TU KHOANG TRANG
			RCALL USART_TRANS ; TRUYEN LEN HERCULES

			LDI DATA_TRANS, 'M' ; LAY MA ASCII CUA CHU M
			RCALL USART_TRANS ; TRUYEN LEN HERCULES

			LDI DATA_TRANS, 'I' ; LAY MA ASCII CUA CHU I
			RCALL USART_TRANS ; TRUYEN LEN HERCULES

			LDI DATA_TRANS, 'T' ; LAY MA ASCII CUA CHU T
			RCALL USART_TRANS ; TRUYEN LEN HERCULES

			LDI DATA_TRANS, 0X20 ; LAY MA ASCII CUA KI TU KHOANG TRANG
			RCALL USART_TRANS ; TRUYEN LEN HERCULES

			LDI DATA_TRANS, 'N' ; LAY MA ASCII CUA CHU N
			RCALL USART_TRANS ; TRUYEN LEN HERCULES

			LDI DATA_TRANS, 'O' ; LAY MA ASCII CUA CHU O
			RCALL USART_TRANS ; TRUYEN LEN HERCULES

			LDI DATA_TRANS, 'N' ; LAY MA ASCII CUA CHU N
			RCALL USART_TRANS ; TRUYEN LEN HERCULES

			LDI DATA_TRANS, ':' ; LAY MA ASCII CUA KI TU ':'
			RCALL USART_TRANS ; TRUYEN LEN HERCULES

			LDI DATA_TRANS, 0X20 ; LAY MA ASCII CUA KI TU KHOANG TRANG
			RCALL USART_TRANS ; TRUYEN LEN HERCULES

			LDI XH, HIGH(NHAP_DON_GIA_ADR + 12) ; X TRO VAO DIA CHI SRAM 0X264 LUU DON GIA MIT NON
			LDI XL, LOW(NHAP_DON_GIA_ADR + 12)

			LDI R16, 4 ; THANH GHI DEM, DEM DU 4 KI TU CUA DON GIA SE DUOC LUU VAO SRAM BAT DAU TU 0X264
NHAP_DON_GIA_4:
			RCALL USART_REC ; LAY VE MA ASCII CUA 4 KI TU CUA DON GIA THUC TE
			ANDI R28, 0X0F ; CHUYEN MA ASCII THANH BCD (VD: MA ASCII LA 0X32, ANDI DE XOA 4 BIT CAO, TRO THANH 0X02 LA SO 2 (BCD))
			ST X+, R28 ; LUU VAO DIA CHI SRAM
			DEC R16 ; GIAM THANH GHI DEM DI 1 DON VI
			BRNE NHAP_DON_GIA_4 ; QUAY LAI NEU CHUA NHAP DU 4 KI TU

			LDI DATA_TRANS, 0X0D ; LAY MA ASCII CUA KI TU XUONG DONG
			RCALL USART_TRANS ; TRUYEN LEN HERCULES

MAIN:
			; SETTING_ADC:
			LDI R16, 0B01001011 ; VREF LA AVCC = 5V, DIF ADC1/0, X200 , HIEU CHINH PHAI
			STS ADMUX, R16

			LDI R16, 0B10100110 ; CHO PHEP ADC, MODE TU KICH, F(ADC) = 125K HZ
			STS ADCSRA, R16

			LDI R16, 0X00 ; MODE TU CHAY, NGUON TAO KICH ADIF
			STS ADCSRB, R16
RUN_ADC:
			LDS R16, ADCSRA
			ORI R16, (1 << ADSC) ; BAT DAU CHUYEN DOI ADC LAN DAU TIEN
			STS ADCSRA, R16
WAIT:
			LDS R18, ADCSRA ; DOC CO ADIF
			SBRS R18, ADIF ; NEU CO ADIF = 1 BAO CHUYEN DOI XONG, BO QUA LENH TIEP THEO
			RJMP WAIT
			STS ADCSRA, R18 ; XOA CO ADIF

			LDS R30, ADCL ; DOC ADCL TRUOC, LUU VAO R30
			LDS R31, ADCH ; DOC ADCH SAU, LUU VAO R31

			LSL R30 ; NHAN 2 GIA TRI ADC VI ADC MODE VI SAI TOI DA CHI CO 512
			ROL R31 ; MUON DOC DEN 1024 THI TA X2

			; (ADC X 2) DUOC LUU TRONG R31:R30
			; GOI NGAN GON GIA TRI (ADC X 2) LA ADC (ADCH:ADCL), LA SO NHI PHAN 10 BIT
			; GIA TRI THAP PHAN TOI DA LA 1024

PHAN_LOAI_MIT:
			CPI R31, 3 ; SO SANH ADCH VOI 3
			BREQ MIT_GIA ; NEU ADCH = 3 THI SO KG LUON LON HON HOAC BANG 7.68, LUON LA MIT GIA

			CPI R31, 2 ; SO SANH ADCH VOI 2
			BREQ MIT_GIA_HOAC_MIT_NGON ; NEU ADCH = 2 THI SO KG LUON LON HON HOAC BANG 5.12, LA MIT GIA HOAC MIT NGON DAT CHUAN

			CPI R31, 1 ; SO SANH ADCH VOI 1
			BREQ MIT_NGON_HOAC_MIT_GAN_CHIN ; NEU ADCH = 1 THI SO KG LUON LON HON HOAC BANG 2.56, LA MIT NGON DAT CHUAN HOAC MIT GAN CHIN TOI

			RJMP MIT_GAN_CHIN_HOAC_MIT_NON ; TRUONG HOP CON LAI: ADCH = 0, CO THE LA MIT NON HOAC MIT GAN CHIN TOI


			; PHAN LOAI MIT GIA/MIT NGON
MIT_GIA_HOAC_MIT_NGON:
			CPI R30, 88 ; 5.12 + 0.88 = 6 KG
			BRCS MIT_NGON ; NEU ADCL BE HON 88 (0.88 KG), ROI VAO TRUONG HOP MIT NGON
			RJMP MIT_GIA ; NEU KHONG THI LA MIT GIA


			; PHAN LOAI MIT NGON/MIT GAN CHIN
MIT_NGON_HOAC_MIT_GAN_CHIN:
			CPI R30, 144 ; 2.56 + 1.44 = 4 KG
			BRCS MIT_GAN_CHIN ; NEU ADCL BE HON 144 (1.44 KG), ROI VAO TRUONG HOP MIT GAN CHIN
			RJMP MIT_NGON ; NEU KHONG THI LA MIT NGON


			; PHAN LOAI MIT GAN CHIN/MIT NON
MIT_GAN_CHIN_HOAC_MIT_NON:
			CPI R30, 200 ; 2 KG
			BRCS MIT_NON ; NEU ADCL BE HON 200 (2 KG), ROI VAO TRUONG HOP MIT NON
			RJMP MIT_GAN_CHIN ; NEU KHONG THI LA MIT GAN CHIN

;------------------------------------------------------------------------------------------------------------------------------
MIT_GIA:
			RCALL LAY_BCD_SO_KG ; LAY SO BCD GIA TRI KG

			RCALL TINH_DON_GIA_MIT_GIA ; TINH GIA TRI THANH GHI DON_GIA = (DON GIA THUC TE X10), DON GIA THUC TE DUOC NHAP TU HERCULES
			RCALL LAY_BCD_DON_GIA ; LAY SO BCD CUA DON GIA

			RCALL TINH_TIEN ; TINH GIA TRI GIA_TIEN LA SO BINARY 24 BIT, SO BCD 6 DIGIT
			RCALL LAY_BCD_GIA_TIEN ; LAY SO BCD GIA MIT

			RJMP MAIN

MIT_NGON:
			RCALL LAY_BCD_SO_KG ; LAY SO BCD GIA TRI KG

			RCALL TINH_DON_GIA_MIT_NGON ; TINH GIA TRI THANH GHI DON_GIA = (DON GIA THUC TE X10), DON GIA THUC TE DUOC NHAP TU HERCULES
			RCALL LAY_BCD_DON_GIA ; LAY SO BCD CUA DON GIA

			RCALL TINH_TIEN ; TINH GIA TRI GIA_TIEN LA SO BINARY 24 BIT, SO BCD 6 DIGIT
			RCALL LAY_BCD_GIA_TIEN ; LAY SO BCD GIA MIT

			RJMP MAIN

MIT_GAN_CHIN:
			RCALL LAY_BCD_SO_KG ; LAY SO BCD GIA TRI KG

			RCALL TINH_DON_GIA_MIT_GAN_CHIN ; TINH GIA TRI THANH GHI DON_GIA = (DON GIA THUC TE X10), DON GIA THUC TE DUOC NHAP TU HERCULES
			RCALL LAY_BCD_DON_GIA ; LAY SO BCD CUA DON GIA

			RCALL TINH_TIEN ; TINH GIA TRI GIA_TIEN LA SO BINARY 24 BIT, SO BCD 6 DIGIT
			RCALL LAY_BCD_GIA_TIEN ; LAY SO BCD GIA MIT

			RJMP MAIN

MIT_NON:
			RCALL LAY_BCD_SO_KG ; LAY SO BCD GIA TRI KG

			RCALL TINH_DON_GIA_MIT_NON ; TINH GIA TRI THANH GHI DON_GIA = (DON GIA THUC TE X10), DON GIA THUC TE DUOC NHAP TU HERCULES
			RCALL LAY_BCD_DON_GIA ; LAY SO BCD CUA DON GIA

			RCALL TINH_TIEN ; TINH GIA TRI GIA_TIEN LA SO BINARY 24 BIT, SO BCD 6 DIGIT
			RCALL LAY_BCD_GIA_TIEN ; LAY SO BCD GIA MIT

			RJMP MAIN

;---------------------------------------------------------------------------------------------------------------------------------------
; INIT_LCD4 KHOI DONG LCD GHI 4 BYTE MA LENH THEO GIAO TIEP 4 BIT
; FUNCTION SET R18 = 0X28 2 DONG FONT 5X8 GIAO TIEP 4 BIT
; CLEAR DISPLAY R19 = 0X01 XOA MAN HINH
; DISPLAY ON/OFF CONTROL R20 = 0X0C MAN HINH ON, CON TRO OFF
; ENTRY MODE SET R21 = 0X06 DICH PHAI CON TRO , DC DDRAM TANG LEN 1 DVI

INIT_LCD4:
			CBI LCD, RS ; GHI LENH
			MOV R17, R18 ; FUNCTION SET
			RCALL OUT_LCD ; GHI RA LCD

			MOV R17, R19 ; CLEAR DISPLAY
			RCALL OUT_LCD ; GHI RA LCD

			LDI R16, 20
			RCALL DELAY_128US ; DELAY 2.56 MS

			MOV R17, R20 ; DISPLAY ON/OFF CONTROL
			RCALL OUT_LCD ; GHI RA LCD

			MOV R17, R21 ; ENTRY MODE SET
			RCALL OUT_LCD ; GHI RA LCD

			RET


;--------------------------------------------------------
; OUT LCD4 GHI MA LENH/ DATA RA LCD
; INPUT R17 CHUA MA LENH/ DATA 4 BIT CAO

OUT_LCD4:
			OUT LCD, R17
			SBI LCD, E
			CBI LCD, E

			RET

;------------------------------------------------------------
; OUT_LCD GHI 1 BYTE MA LENH/DATA RA LCD
; CHIA LAM 2 LAN GHI 4 BIT
; INPUT R17 CHUA MA LENH/DATA
; RS = 0/1 LENH/DATA
; RW = 0 GHI
; SU DUNG OUT_LCD4

OUT_LCD:
			LDI R16, 1
			RCALL DELAY_128US

			IN R16, LCD ; DOC PORT LCD
			ANDI R16, (1 << RS) ; LOC BIT RS

			PUSH R16 ; LUU TRU R16
			PUSH R17 ; LUU TRU R17

			ANDI R17, 0XF0 ; LAY 4 BIT CAO
			OR R17, R16 ; GHEP BIT RS
			RCALL OUT_LCD4 ; GHI RA LCD

			LDI R16, 1
			RCALL DELAY_128US

			POP R17
			POP R16

			SWAP R17 ; SWAP 2 NIBBLE
			ANDI R17, 0XF0 ; LAY 4 BIT THAP CHUYEN THANH CAO
			OR R17, R16 ; GHEP BIT RS
			RCALL OUT_LCD4 ; GHI RA LCD

			RET

;-----------------------------------------------------------------------------------------
; CURS_POS DAT CON TRO VI TRI LCD TAI DIA CHI CO TRONG R17

CURS_POS:
			LDI R16, 1
			RCALL DELAY_128US
			CBI LCD, RS ; GHI LENH
			RCALL OUT_LCD

			RET

;---------------------------------------------------------------------------------------------
; KHOI DONG BO USART

USART_INIT:
			LDI R16, (1 << TXEN0)|(1 << RXEN0); CHO PHEP BO PHAT VA BO THU
			STS UCSR0B, R16

			LDI R16, (1 << UCSZ01)|(1 << UCSZ00) ; 8 BIT DATA/KHONG KT CHAN LE/1 STOP BIT
			STS UCSR0C, R16

			LDI R16, 0
			STS UBRR0H, R16
			LDI R16, 51 ; BAUD RATE = 9600 UNG VOI FOSC = 8MHZ
			STS UBRR0L, R16

			RET

;-------------------------------------------------------------------------------------------------------------------------------------
; TRUYEN KI TU CO TRONG THANH GHI DATA_TRANS LEN HERCULES

USART_TRANS:
			LDS R17, UCSR0A
			SBRS R17, UDRE0 ; KIEM TRA UDR0 CO TRONG KHONG (UDRE0 = 1?)
			RJMP USART_TRANS
			STS UDR0, DATA_TRANS ; KHI UDR0 TRONG THI CHEP DU LIEU TU DATA_TRANS CHUA THANH GHI CAN XUAT VAO UDR0

			RET

;-------------------------------------------------------------------------------------------------------------------------------------
; NHAN KI TU TU HERCULES XUONG THANH GHI R28 (DATA_REC)

USART_REC:
			; R28 LA DATA_REC
			LDS R17, UCSR0A
			SBRS R17, RXC0
			RJMP USART_REC
			LDS R28, UDR0 ; NAP DU LIEU TU UDR0 VAO DATA_REC (R28)

			RET


;----------------------------------------------------------------------------------------------------

TINH_DON_GIA_MIT_GIA:
; CHUONG TRINH CON TINH GIA TRI CUA THANH GHI DON_GIA = (DON GIA THUC TE X10) CUA MIT GIA

; 4 KI TU CUA DON GIA THUC TE CUA MIT GIA DUOC LUU O DIA CHI SRAM TU 0X260 DEN 0X263
; VD: KHI NGUOI DUNG NHAP VAO "12.5" THI:
; '1' DUOC LUU O 0X260, LA BCD HANG TRAM CUA THANH GHI DON_GIA
; '2' DUOC LUU O 0X261, LA BCD HANG CHUC CUA THANH GHI DON_GIA
; '.' DUOC LUU O 0X262, LA DAU CHAM THAP PHAN
; '5' DUOC LUU O 0X263, LA BCD HANG DON VI CUA THANH GHI DON GIA

; TINH GIA TRI THANH GHI DON_GIA BANG CACH LAY:
; (BCD HANG TRAM)x100 + (BCD HANG CHUC)x10 + (BCD HANG DON VI) -> THANH GHI DON_GIA
; BO QUA DAU CHAM THAP PHAN

			LDI XH, HIGH(NHAP_DON_GIA_ADR) ; X TRO VAO 0X260
			LDI XL, LOW(NHAP_DON_GIA_ADR)
			CLR DON_GIA ; CLEAR THANH GHI DON GIA TRUOC KHI SU DUNG

			LD R16, X+ ; LAY BCD HANG TRAM
			LDI R17, 100
			MUL R16, R17 ; NHAN BCD HANG TRAM CHO 100, KET QUA CHUA TRONG R0
			ADD DON_GIA, R0 ; CONG THANH GHI_DON GIA VOI R0

			LD R16, X+ ; LAY BCD HANG CHUC
			LDI R17, 10
			MUL R16, R17 ; NHAN BCD HANG CHUC CHO 10, KET QUA CHUA TRONG R0
			ADD DON_GIA, R0 ; CONG THANH GHI DON_GIA VOI R0

			LD R16, X+ ; X LUC NAY TRO VAO DIA CHIA SRAM CUA DAU CHAM THAP PHAN, TA BO QUA

			LD R16, X+ ; LAY BCD HANG DON VI
			ADD DON_GIA, R16 ; CONG THANH GHI DON_GIA VOI BCD HANG DON VI

			RET

;----------------------------------------------------------------------------------------------------

TINH_DON_GIA_MIT_NGON:
; CHUONG TRINH CON TINH GIA TRI CUA THANH GHI DON_GIA = (DON GIA THUC TE X10) CUA MIT NGON

; 4 KI TU CUA DON GIA THUC TE CUA MIT NGON DUOC LUU O DIA CHI SRAM TU 0X264 DEN 0X267
; VD: KHI NGUOI DUNG NHAP VAO "12.5" THI:
; '1' DUOC LUU O 0X264, LA BCD HANG TRAM CUA THANH GHI DON_GIA
; '2' DUOC LUU O 0X265, LA BCD HANG CHUC CUA THANH GHI DON_GIA
; '.' DUOC LUU O 0X266, LA DAU CHAM THAP PHAN
; '5' DUOC LUU O 0X267, LA BCD HANG DON VI CUA THANH GHI DON GIA

; TINH GIA TRI THANH GHI DON_GIA BANG CACH LAY:
; (BCD HANG TRAM)x100 + (BCD HANG CHUC)x10 + (BCD HANG DON VI) -> THANH GHI DON_GIA
; BO QUA DAU CHAM THAP PHAN

			LDI XH, HIGH(NHAP_DON_GIA_ADR + 4) ; X TRO VAO 0X264
			LDI XL, LOW(NHAP_DON_GIA_ADR + 4)
			CLR DON_GIA ; CLEAR THANH GHI DON GIA TRUOC KHI SU DUNG

			LD R16, X+ ; LAY BCD HANG TRAM
			LDI R17, 100
			MUL R16, R17 ; NHAN BCD HANG TRAM CHO 100, KET QUA CHUA TRONG R0
			ADD DON_GIA, R0 ; CONG THANH GHI_DON GIA VOI R0

			LD R16, X+ ; LAY BCD HANG CHUC
			LDI R17, 10
			MUL R16, R17 ; NHAN BCD HANG CHUC CHO 10, KET QUA CHUA TRONG R0
			ADD DON_GIA, R0 ; CONG THANH GHI DON_GIA VOI R0

			LD R16, X+ ; X LUC NAY TRO VAO DIA CHIA SRAM CUA DAU CHAM THAP PHAN, TA BO QUA

			LD R16, X+ ; LAY BCD HANG DON VI
			ADD DON_GIA, R16 ; CONG THANH GHI DON_GIA VOI BCD HANG DON VI

			RET


;----------------------------------------------------------------------------------------------------

TINH_DON_GIA_MIT_GAN_CHIN:
; CHUONG TRINH CON TINH GIA TRI CUA THANH GHI DON_GIA = (DON GIA THUC TE X10) CUA MIT GAN CHIN

; 4 KI TU CUA DON GIA THUC TE CUA MIT GAN CHIN DUOC LUU O DIA CHI SRAM TU 0X268 DEN 0X26B
; VD: KHI NGUOI DUNG NHAP VAO "12.5" THI:
; '1' DUOC LUU O 0X268, LA BCD HANG TRAM CUA THANH GHI DON_GIA
; '2' DUOC LUU O 0X269, LA BCD HANG CHUC CUA THANH GHI DON_GIA
; '.' DUOC LUU O 0X26A, LA DAU CHAM THAP PHAN
; '5' DUOC LUU O 0X26B, LA BCD HANG DON VI CUA THANH GHI DON GIA

; TINH GIA TRI THANH GHI DON_GIA BANG CACH LAY:
; (BCD HANG TRAM)x100 + (BCD HANG CHUC)x10 + (BCD HANG DON VI) -> THANH GHI DON_GIA
; BO QUA DAU CHAM THAP PHAN

			LDI XH, HIGH(NHAP_DON_GIA_ADR + 8) ; X TRO VAO 0X268
			LDI XL, LOW(NHAP_DON_GIA_ADR + 8)
			CLR DON_GIA ; CLEAR THANH GHI DON GIA TRUOC KHI SU DUNG

			LD R16, X+ ; LAY BCD HANG TRAM
			LDI R17, 100
			MUL R16, R17 ; NHAN BCD HANG TRAM CHO 100, KET QUA CHUA TRONG R0
			ADD DON_GIA, R0 ; CONG THANH GHI_DON GIA VOI R0

			LD R16, X+ ; LAY BCD HANG CHUC
			LDI R17, 10
			MUL R16, R17 ; NHAN BCD HANG CHUC CHO 10, KET QUA CHUA TRONG R0
			ADD DON_GIA, R0 ; CONG THANH GHI DON_GIA VOI R0

			LD R16, X+ ; X LUC NAY TRO VAO DIA CHIA SRAM CUA DAU CHAM THAP PHAN, TA BO QUA

			LD R16, X+ ; LAY BCD HANG DON VI
			ADD DON_GIA, R16 ; CONG THANH GHI DON_GIA VOI BCD HANG DON VI

			RET


;----------------------------------------------------------------------------------------------------

TINH_DON_GIA_MIT_NON:
; CHUONG TRINH CON TINH GIA TRI CUA THANH GHI DON_GIA = (DON GIA THUC TE X10) CUA MIT NON

; 4 KI TU CUA DON GIA THUC TE CUA MIT NON DUOC LUU O DIA CHI SRAM TU 0X26C DEN 0X26F
; VD: KHI NGUOI DUNG NHAP VAO "12.5" THI:
; '1' DUOC LUU O 0X26C, LA BCD HANG TRAM CUA THANH GHI DON_GIA
; '2' DUOC LUU O 0X26D, LA BCD HANG CHUC CUA THANH GHI DON_GIA
; '.' DUOC LUU O 0X26E, LA DAU CHAM THAP PHAN
; '5' DUOC LUU O 0X26F, LA BCD HANG DON VI CUA THANH GHI DON GIA

; TINH GIA TRI THANH GHI DON_GIA BANG CACH LAY:
; (BCD HANG TRAM)x100 + (BCD HANG CHUC)x10 + (BCD HANG DON VI) -> THANH GHI DON_GIA
; BO QUA DAU CHAM THAP PHAN

			LDI XH, HIGH(NHAP_DON_GIA_ADR + 12) ; X TRO VAO 0X26C
			LDI XL, LOW(NHAP_DON_GIA_ADR + 12)
			CLR DON_GIA ; CLEAR THANH GHI DON GIA TRUOC KHI SU DUNG

			LD R16, X+ ; LAY BCD HANG TRAM
			LDI R17, 100
			MUL R16, R17 ; NHAN BCD HANG TRAM CHO 100, KET QUA CHUA TRONG R0
			ADD DON_GIA, R0 ; CONG THANH GHI_DON GIA VOI R0

			LD R16, X+ ; LAY BCD HANG CHUC
			LDI R17, 10
			MUL R16, R17 ; NHAN BCD HANG CHUC CHO 10, KET QUA CHUA TRONG R0
			ADD DON_GIA, R0 ; CONG THANH GHI DON_GIA VOI R0

			LD R16, X+ ; X LUC NAY TRO VAO DIA CHIA SRAM CUA DAU CHAM THAP PHAN, TA BO QUA

			LD R16, X+ ; LAY BCD HANG DON VI
			ADD DON_GIA, R16 ; CONG THANH GHI DON_GIA VOI BCD HANG DON VI

			RET


; -----------------------------------------------------------------------------------------------------------------------------------------
; LAY_BCD_DON_GIA CHUYEN SO NHI PHAN 8 BIT (DON_GIA) SANG SO BCD 3 DIGIT
; SAU DO CHUYEN CAC SO BCD NAY THANH MA ASCII TUONG UNG
; LUU DONG CHU: EF.G USD/KG VA KI TU KET THUC (0X00) VAO DIA CHI SRAM TU 0X20B DEN 0X200
; VOI EF.G LA DON GIA THUC TE

; INPUT: DON_GIA = SO NHI PHAN 8 BIT
; OUTPUT: LUU MA ASCII CUA CAC SO BCD CUA DON_GIA VA DONG CHU "USD/KG" VA KI TU KET THUC (0X00) VAO CAC O DIA CHI BAT DAU TU USD_PER_KG_ADR (0X200)
; DAT DAU CHAM (.) THAP PHAN VAO DUNG VI TRI DE RA DUOC DON GIA MIT THUC TE

; SU DUNG CTC DIV2 , SO CHIA = 10

LAY_BCD_DON_GIA:
			PUSH DON_GIA ; BAO TOAN GIA TRI DON_GIA DE SU DUNG TIEP TINH GIA TIEN

			LDI XH, HIGH(USD_PER_KG_ADR) ; X TRO VAO DIA CHI SRAM USD_PER_KG_ADR LUU MA ASCII CUA CAC BCD CUA DON GIA
			LDI XL, LOW(USD_PER_KG_ADR)

			LDI R16, 0X00
			ST X+, R16 ; LUU MA ASCII CUA KI TU KET THUC (LINE 2 LCD) VAO USD_PER_KG_ADR (0X200)

			LDI R16, 'G'
			ST X+, R16 ; LUU MA ASCII CUA CHU G VAO USD_PER_KG_ADR + 1 (0X201)

			LDI R16, 'K'
			ST X+, R16 ; LUU MA ASCII CUA CHU K VAO USD_PER_KG_ADR + 2 (0X202)

			LDI R16, '/'
			ST X+, R16 ; LUU MA ASCII CUA DAU '/' VAO USD_PER_KG_ADR +3 (0X203)

			LDI R16, 'D'
			ST X+, R16 ; LUU MA ASCII CUA CHU D VAO USD_PER_KG_ADR + 4 (0X204)

			LDI R16, 'S'
			ST X+, R16 ; LUU MA ASCII CUA CHU S VAO USD_PER_KG_ADR + 5 (0X205)

			LDI R16, 'U'
			ST X+, R16 ; LUU MA ASCII CUA CHU U VAO USD_PER_KG_ADR + 6 (0X206)

			LDI R16, 0X20
			ST X+, R16 ; LUU MA ASCII CUA KI TU KHOANG TRANG VAO USD_PER_KG_ADR + 7 (0X207)

			RCALL DIV2
			ORI R16, 0X30 ; CHUYEN BCD HANG DON VI THANH MA ASCII
			ST X+, R16 ; LUU MA ASCII CUA BCD DON VI VAO USD_PER_KG_ADR + 8 (0X208)

			LDI R16, '.' ; LAY MA ASCII CUA DAU CHAM THAP PHAN
			ST X+, R16 ; LUU VAO USD_PER_KG_ADR + 9 (0X209)

			RCALL DIV2
			ORI R16, 0X30 ; CHUYEN BCD HANG CHUC THANH MA ASCII
			ST X+, R16 ; LUU MA ASCII CUA BCD HANG CHUC VAO USD_PER_KG_ADR + 10 (0X20A)

			RCALL DIV2
			ORI R16, 0X30 ; CHUYEN BCD HANG TRAM THANH MA ASCII
			ST X+, R16 ; LUU MA ASCII CUA BCD HANG TRAM VAO USD_PER_KG_ADR + 11 (0X20B)

			; DIA CHI SRAM TU 0X20B DEN 0X200 SE LUU "EF.G USD/KG" VA KI TU 0X00 (KET THUC) VOI EF.G LA DON GIA CUA TUNG LOAI MIT

			POP DON_GIA

			RET



;--------------------------------------------------------------
; DIV2 CHIA SO NHI PHAN 8 BIT (DON_GIA) CHO 8 BIT (10)
; CHIA BANG CACH TRU NHIEU LAN CHO SO CHIA

; INPUT: DON_GIA LA SO BI CHIA, SO CHIA = 10
; OUTPUT: DON_GIA LA THUONG SO, R16 LA DU SO

; SD R28 DE CAT THUONG SO TAM

DIV2:
			CLR R28
			LDI R29, 10
GT_DV2:
			SUBI DON_GIA, 10
			BRCS LT_DV2 ; C = 1 KHONG CHIA DUOC
			INC R28
			RJMP GT_DV2
LT_DV2:
			ADD DON_GIA, R29 ; LAY LAI DU SO
			MOV R16, DON_GIA ; R16 = DU SO
			MOV DON_GIA, R28 ; GIA_CO_DINH = THUONG SO

			RET



; ------------------------------------------------------------------------------------------------------------------------------------
; LAY_BCD_SO_KG CHUYEN SO NHI PHAN 12 BIT (ADC X 2, HAY GOI NGAN GON LA ADC) SANG SO BCD 4 DIGIT
; SAU DO CHUYEN CAC SO BCD NAY THANH MA ASCII TUONG UNG
; LUU DONG CHU: AB.CD KG VA KI TU XUONG DONG (0X0D) VAO DIA CHI SRAM TU 0X214 DEN 0X20C
; VOI AB.CD LA SO KG THUC TE

; INPUT: ADC_HIGH:ADC_LOW = SO NHI PHAN 16 BIT
; OUTPUT: LUU MA ASCII CUA CAC SO BCD CUA SO KG VA DONG CHU "KG" VA KI TU XUONG DONG (0X0D) VAO CAC O DIA CHI BAT DAU TU KG_ADR (0X20C)
; DAT DAU CHAM (.) THAP PHAN VAO DUNG VI TRI DE RA DUOC SO KG

; SU DUNG CTC DIV1 , SO CHIA = 10

LAY_BCD_SO_KG:
			PUSH R30
			PUSH R31 ; BAO TOAN GIA TRI ADC DE SU DUNG TIEP TINH GIA TIEN

			LDI XH, HIGH(KG_ADR) ; X TRO VAO DIA CHI SRAM KG_ADR LUU MA ASCII CUA CAC BCD CUA SO KG
			LDI XL, LOW(KG_ADR)

			LDI R16, 0X0D
			ST X+, R16 ; LUU MA ASCII CUA KI TU XUONG DONG DE NHAN BIET KET THUC DONG 1 LCD VAO KG_ADR (0X20C)

			LDI R16, 'G'
			ST X+, R16 ; LUU MA ASCII CUA CHU G VAO KG_ADR + 1 (0X20D)

			LDI R16, 'K'
			ST X+, R16 ; LUU MA ASCII CUA CHU K VAO KG_ADR + 2 (0X20E)

			LDI R16, 0X20
			ST X+, R16 ; LUU MA ASCII CUA KI TU KHOANG TRANG VAO KG_ADR + 3 (0X20F)

			RCALL DIV1
			ORI R16, 0X30 ; CHUYEN BCD DON VI THANH MA ASCII
			ST X+, R16 ; LUU MA ASCII CUA BCD DON VI VAO KG_ADR + 4 (0X210)

			RCALL DIV1
			ORI R16, 0X30 ; CHUYEN BCD HANG CHUC THANH MA ASCII
			ST X+, R16 ; LUU MA ASCII CUA BCD HANG CHUC VAO KG_ADR + 5 (0X211)

			LDI R16, '.' ; LAY MA ASCII CUA DAU CHAM THAP PHAN
			ST X+, R16 ; LUU VAO KG_ADR + 6 (0X212)

			RCALL DIV1
			ORI R16, 0X30 ; CHUYEN BCD HANG TRAM THANH MA ASCII
			ST X+, R16 ; LUU MA ASCII CUA BCD HANG TRAM VAO KG_ADR + 7 (0X213)

			RCALL DIV1
			ORI R16, 0X30 ; CHUYEN BCD HANG NGHIN THANH MA ASCII
			ST X+, R16 ; LUU MA ASCII CUA BCD HANG NGHIN VAO KG_ADR + 8 (0X214)

			; DIA CHI SRAM TU 0X214 DEN 0X20C SE LUU "AB.CD KG" VA KI TU 0X0D (XUONG DONG) VOI AB.CD LA SO KG DOC DUOC TU BO ADC

			POP R31
			POP R30 ; POP THEO QUY TAC LAST IN FIRST OUT

			RET

;--------------------------------------------------------------------------------------------------------------------
; DIV1 CHIA SO NHI PHAN 12 BIT (ADC) CHO 8 BIT (10)
; CHIA BANG CACH TRU NHIEU LAN CHO SO CHIA

; INPUT: ADC_HIGH:ADC_LOW LA SO BI CHIA, SO CHIA = 10
; OUTPUT: ADC_HIGH:ADC_LOW LA THUONG SO, R16 LA DU SO

; SD R28:R29 DE CAT THUONG SO TAM

DIV1:
			CLR R28
			CLR R29
GT_DV1:
			SBIW R30, 10
			BRCS LT_DV1 ; C = 1 KHONG CHIA DUOC
			ADIW R28, 1
			RJMP GT_DV1
LT_DV1:
			ADIW R30, 10 ; LAY LAI DU SO
			MOV R16, R30 ; R16 = DU SO
			MOVW R30, R28 ; ADC_HIGH:ADC_LOW = THUONG SO

			RET




;-------------------------------------------------------------------------------------------------------------
; TINH_TIEN: NHAN SO NHI PHAN 12 BIT (ADC X 2, HAY GOI NGAN GON LA ADC) CHO 8 BIT (DON_GIA), KET QUA 24 BIT
; NHAN BANG CACH CONG ADC CHO CHINH NO (DON_GIA) LAN

; INPUT: ADC_HIGH:ADC_LOW (R31:R30) LA SO BI NHAN 12 BIT, DON_GIA LA SO NHAN 8 BIT
; OUTPUT: GIA_TIEN_HIGH:GIA_TIEN_MIDDLE:GIA_TIEN_LOW

; SU DUNG R2, R3, R4, R17 LAM CAC THANH GHI TAM THOI

TINH_TIEN:
			CLR R2
			CLR R3
			CLR R4 ; CLEAR CAC THANH GHI TAM THOI
MULTI:
			LDI R21, 0
			ADD R2, R30 ; CONG LIEN TIEP R2 VOI ADCL
			ADC R3, R31 ; CONG LIEN TIEP R3 VOI ADCH VA CARRY (NEU CO)
			ADC R4, R21 ; CONG LIEN TIEP R4 VOI CARRY (NEU CO)
			DEC DON_GIA ; DON_GIA DONG VAI TRO LA SO DEM
			BRNE MULTI

			MOV GIA_TIEN_LOW, R2
			MOV GIA_TIEN_MIDDLE, R3
			MOV GIA_TIEN_HIGH, R4 ; CHUYEN CAC GIA TRI TRONG R4:R3:R2 SANG 3 THANH GHI GIA_TIEN

			RET


; ----------------------------------------------------------------------------------------------------------------------------------------------
; LAY_BCD_GIA_TIEN CHUYEN SO NHI PHAN 24 BIT (GIA_TIEN_HIGH:GIA_TIEN_MIDDLE:GIA_TIEN_LOW) SANG SO BCD 6 DIGIT
; SAU DO CHUYEN CAC SO BCD NAY THANH MA ASCII TUONG UNG

; INPUT: GIA_TIEN_HIGH:GIA_TIEN_MIDDLE:GIA_TIEN_LOW = SO NHI PHAN 24 BIT
; OUTPUT: LUU MA ASCII CUA CAC SO BCD CUA GIA_TIEN(HIGH:MIDDLE:LOW) VA CAC KI TU ASCII KHAC VAO CAC O DIA CHI BAT DAU TU PAY_ADR DE XUAT RA LCD
; DAT DAU CHAM (.) THAP PHAN VAO DUNG VI TRI DE RA DUOC GIA TIEN THUC TE

; SU DUNG CTC DIV3 , SO CHIA = 10

LAY_BCD_GIA_TIEN:

			LDI XH, HIGH(PAY_ADR) ; X TRO VAO DIA CHI SRAM PAY_ADR LUU MA ASCII CUA CAC BCD CUA GIA TIEN CUOI CUNG
			LDI XL, LOW(PAY_ADR)

			LDI R16, 0X00
			ST X+, R16 ; LUU MA ASCII CUA KI TU KET THUC (LINE 2 LCD) VAO PAY_ADR (0X240)

			RCALL DIV3
			ORI R16, 0X30 ; CHUYEN BCD HANG DON VI THANH MA ASCII
			ST X+, R16 ; LUU MA ASCII CUA BCD DON VI VAO PAY_ADR + 1 (0X241)

			RCALL DIV3
			ORI R16, 0X30 ; CHUYEN BCD HANG CHUC THANH MA ASCII
			ST X+, R16 ; LUU ASCII CUA BCD HANG CHUC VAO PAY_ADR + 2 (0X242)

			RCALL DIV3
			ORI R16, 0X30 ; CHUYEN BCD HANG CHUC THANH MA ASCII
			ST X+, R16 ; LUU ASCII CUA BCD HANG TRAM VAO PAY_ADR + 3 (0X243)

			LDI R16, '.' ; LAY MA ASCII CUA DAU CHAM THAP PHAN
			ST X+, R16 ; LUU VAO PAY_ADR + 4 (0X244)

			RCALL DIV3
			ORI R16, 0X30 ; CHUYEN BCD HANG TRAM THANH MA ASCII
			ST X+, R16 ; LUU MA ASCII CUA BCD HANG NGHIN VAO PAY_ADR + 5 (0X245)

			RCALL DIV3
			ORI R16, 0X30 ; CHUYEN BCD HANG NGHIN THANH MA ASCII
			ST X+, R16 ; LUU MA ASCII CUA BCD HANG CHUC NGHIN VAO PAY_ADR + 6 (0X246)

			RCALL DIV3
			ORI R16, 0X30 ; CHUYEN BCD HANG CHUC NGHIN THANH MA ASCII
			ST X+, R16 ; LUU MA ASCII CUA BCD HANG TRAM NGHIN VAO PAY_ADR + 7 (0X247)

			LDI R16, 0X0D
			ST X+, R16 ; LUU MA ASCII CUA KI TU XUONG DONG DE BIET KET THUC DONG 1 VAO PAY_ADR + 8 (0X248)

			LDI R16, 'N'
			ST X+, R16 ; LUU MA ASCII CUA CHU N VAO PAY_ADR + 9 (0X249)

			LDI R16, 'E'
			ST X+, R16 ; LUU MA ASCII CUA CHU E VAO PAY_ADR + 10 (0X24A)

			LDI R16, 'I'
			ST X+, R16 ; LUU MA ASCII CUA CHU I VAO PAY_ADR + 11 (0X24B)

			LDI R16, 'T'
			ST X+, R16 ; LUU MA ASCII CUA CHU T VAO PAY_ADR + 12 (0X24C)

			LDI R16, 0X20
			ST X+, R16 ; LUU MA ASCII CUA KI TU KHOANG TRANG VAO PAY_ADR + 13 (0X24D)

			LDI R16, 'H'
			ST X+, R16 ; LUU MA ASCII CUA CHU H VAO PAY_ADR + 14 (0X24E)

			LDI R16, 'N'
			ST X+, R16 ; LUU MA ASCII CUA CHU N VAO PAY_ADR + 15 (0X24F)

			LDI R16, 'A'
			ST X+, R16 ; LUU MA ASCII CUA CHU A VAO PAY_ADR + 16 (0X250)

			LDI R16, 'H'
			ST X+, R16 ; LUU MA ASCII CUA CHU H VAO PAY_ADR + 17 (0X251)

			LDI R16, 'T'
			ST X+, R16 ; LUU MA ASCII CUA CHU T VAO PAY_ADR + 18 (0X252)

			RET

;----------------------------------------------------------------------------------------
; DIV3 CHIA SO NHI PHAN 24 BIT (GIA_TIEN) CHO 8 BIT (10), KET QUA LA SO 24 BIT
; CHIA BANG CACH TRU NHIEU LAN CHO SO CHIA

; INPUT: GIA_TIEN_HIGH:GIA_TIEN_MIDDLE:GIA_TIEN_LOW LA SO BI CHIA, SO CHIA = 10
; OUTPUT: GIA_TIEN_HIGH:GIA_TIEN_MIDDLE:GIA_TIEN_LOW LA THUONG SO 24 BIT, R16 LA DU SO

; SU DUNG R20, R21, R22 CHUA THUONG SO TAM THOI

DIV3:
			CLR R20
			CLR R21
			CLR R22 ; CLEAR CAC THANH GHI CHUA THUONG SO TAM THOI
LOOP:
			INC R20 ; TANG R20 LEN 1 DON VI
			BRNE LP1 ; NEU R20 OVERFLOW TU 0XFF THANH 0X00, TANG R21 LEN 1 DON VI
			INC R21
LP1:
			BRNE LP2 ; NEU R21 OVERFLOW TU 0XFF THANH 0X00, TANG R22 LEN 1 DON VI
			INC R22
LP2:
			SUBI GIA_TIEN_LOW, 10 ; TRU GIA_TIEN_LOW CHO 10
			BRCC LOOP
			; NEU GIA_TIEN_LOW < 10, (GIA_TIEN_LOW - 10) < 0, (GIA_TIEN_LOW - 10) SE BI TRAN, CARRY = 1, TRU GIA_TIEN_MIDDLE DI 1 DON VI (1 DON VI NAY LA CARRY)
			; VD: GIA_TIEN_LOW = 0X09, (GIA_TIEN_LOW - 10) = 0XFF, LUC NAY TA SE TRU GIA TIEN MIDDLE DI 1 DON VI
			SUBI GIA_TIEN_MIDDLE, 1
			BRCC LOOP
			; NEU (GIA_TIEN_MIDDLE - 1) BI TRAN, CARRY = 1, TRU GIA_TIEN_HIGH DI 1 DON VI (1 DON VI NAY LA CARRY)
			SUBI GIA_TIEN_HIGH, 1
			BRCC LOOP
			; NEU (GIA_TIEN_HIGH - 1) BI TRAN, CARRY = 1, LUC NAY KHONG CHIA DUOC NUA VI SO DU BI AM (SO DU < 0), TA SE DI LAY LAI SO DU BANG CACH LAY SO DU BI AM + 10
			; TRU THUONG SO TAM THOI R22:R21:R20 CHO 1 DE RA THUONG SO CHINH XAC, THUONG SO DUOC TANG THEM 1 O LAN TRU CUOI CUNG MA CARRY = 1

			LDI R17, 10
			CLR R15

			ADD GIA_TIEN_LOW, R17 ; GIA_TIEN_LOW LUC NAY LA SO DU BI AM, (GIA_TIEN_LOW + 10) = SO DU NGAY TRUOC KHI CARRY = 1

			SUBI R20, 1 ; TRU 8 BIT THAP CUA THUONG SO VOI 1
			SBCI R21, 0 ; NEU 8 BIT THAP BI TRAN, TRU 8 BIT MIDDLE CHO 1 (SO 1 NAY LA CARRY)
			SBCI R22, 0 ; NEU 8 BIT MIDDLE BI TRAN, TRU 8 BIT CAO CHO 1 (SO 1 NAY LA CARRY)

			MOV R16, GIA_TIEN_LOW ; CHUYEN SO DU VAO R16

			MOV GIA_TIEN_LOW, R20
			MOV GIA_TIEN_MIDDLE, R21
			MOV GIA_TIEN_HIGH, R22 ; CHUYEN THUONG SO TAM THOI VAO LAI 3 THANH GHI GIA_TIEN DE CHUAN BI CHO LAN CHIA TIEP THEO

			RET




;-----------------------------------------------------------------------------------
; DELAY_128US TAO DELAY BANG TIMER 1 CTC KENH A
; TIMER 1, CHIA 1024, MOI XUNG CHUA TRONG R16 LA 128US
; DELAY (128U X R16)s

DELAY_128US:
			STS OCR1AL, R16 ; OCR1AL CHUA HET R16 NEN KHONG CAN XET DEN OCR1AH
			LDI R16, 0X00

			STS TCCR1A, R16 ; TIMER 1
			LDI R16, 0X0D
			STS TCCR1B, R16 ; MODE CTC CHIA 1024 START
OCF1A_FLAG_1:
			SBIS TIFR1, OCF1A ; CHO CO OCF1A = 1 BAO KET QUA SO SANH KENH A
			RJMP OCF1A_FLAG_1 ; OCF1A = 0 TIEP TUC CHO
			SBI TIFR1, OCF1A ; KHI OCF1A = 1, GHI TIEP 1 VAO OCF1A DE XOA CO

			RET



;------------------------------------------------------------------------------------------------------
; INT0_ISR NGAT KHI PD2 (SW0) TAC DONG CANH XUONG (SW DUOC NHAN)
; KHI CO YEU CAU THUC HIEN NGAT INT0 O SWITCH 0, HIEN THI LCD NHU SAU:
; LINE 1: "AB.CD KG" ; LINE 2: "EF.G USD/KG"
; VOI AB.CD LA SO KG THUC TE, EF.G LA DON GIA THUC TE

INT0_ISR:
			; HIEN THI SO KG VA DON GIA

			LDI R16, 1
			RCALL DELAY_128US ; DELAY 128US
			CBI LCD, RS ; GHI LENH
			LDI R17, 0X01 ; XOA MAN HINH
			RCALL OUT_LCD

			LDI R16, 20
			RCALL DELAY_128US ; DELAY SAU LENH CLEAR DISPLAY

			LDI R17, 0X80 ; CON TRO BAT DAU O HANG 1 VI TRI SO 1
			RCALL CURS_POS

			LDI XH, HIGH(LCD_END_ADR) ; X TRO VAO 0X215
			LDI XL, LOW(LCD_END_ADR)

LINE1_0:
			LD R17, -X ; X = X - 1 = 0X214, (X) -> R17
			; LAY MA ASCII KY TU TU SRAM, LAN LUOT LAY MA ASCII TU 0X214 DEN 0X200
			CPI R17, 0X0D ; KIEM TRA CO PHAI KY TU XUONG DONG HAY KHONG
			BREQ DOWN_0 ; NEU LA KI TU XUONG DONG, NHAY TOI DOWN_0

			LDI R16, 1 ; DELAY 128US
			RCALL DELAY_128US

			SBI LCD, RS ; RS = 1 GHI DATA HIEN THI RA LCD
			RCALL OUT_LCD
			RJMP LINE1_0 ; QUAY VE HIEN THI TIEP DONG 1 CUA LCD
DOWN_0:
			LDI R16, 1
			RCALL DELAY_128US ; DELAY 128US

			CBI LCD, RS ; RS = 0 GHI LENH
			LDI R17, 0XC0 ; CON TRO BAT DAU O DONG 2 VI TRI SO 1
			RCALL CURS_POS
LINE2_0:
			LD R17, -X
			CPI R17, 0X00 ; KIEM TRA CO PHAI KI TU KET THUC HAY KHONG
			BREQ STOP_0 ; NEU LA KI TU KET THUC, NHAY TOI STOP_0
			LDI R16, 1
			RCALL DELAY_128US
			SBI LCD, RS ; RS = 1 GHI LENH
			RCALL OUT_LCD ; XUAT RA LCD
			RJMP LINE2_0 ; HIEN THI TIEP DONG 2 CUA LCD
STOP_0:
			LDI R16, 1
			RCALL DELAY_128US

			RETI



;------------------------------------------------------------------------------------------------------
; INT1_ISR NGAT KHI PD3 (SW1) TAC DONG CANH XUONG (SW DUOC NHAN)
; KHI CO YEU CAU THUC HIEN NGAT INT1 O SWITCH 1, HIEN THI LCD NHU SAU:
; LINE 1: "THANH TIEN" ; LINE 2: "HIJ.KLM USD"
; VOI HIJ.KLM LA GIA TIEN THUC TE

INT1_ISR:
			; HIEN THI GIA TIEN

			LDI R16, 1
			RCALL DELAY_128US ; DELAY 128US
			CBI LCD, RS ; GHI LENH
			LDI R17, 0X01 ; XOA MAN HINH
			RCALL OUT_LCD

			LDI R16, 20
			RCALL DELAY_128US ; DELAY SAU LENH CLEAR DISPLAY

			LDI R17, 0X83 ; CON TRO BAT DAU O HANG 1 VI TRI SO 4
			RCALL CURS_POS

			LDI XH, HIGH(PAY_ADR + 19) ; X TRO VAO 0X253
			LDI XL, LOW(PAY_ADR + 19)

LINE1_1:
			LD R17, -X ; BAN DAU X = X - 1 = 0X252, (X) -> R17
			; LAY MA ASCII KY TU TU SRAM, LAN LUOT LAY MA ASCII TU 0X252 DEN 0X240
			CPI R17, 0X0D ; KIEM TRA CO PHAI KY TU XUONG DONG HAY KHONG
			BREQ DOWN_1 ; NEU LA KI TU XUONG DONG, NHAY TOI DOWN_1

			LDI R16, 1 ; DELAY 128US
			RCALL DELAY_128US

			SBI LCD, RS ; RS = 1 GHI DATA HIEN THI RA LCD
			RCALL OUT_LCD
			RJMP LINE1_1 ; QUAY VE HIEN THI TIEP DONG 1 CUA LCD
DOWN_1:
			LDI R16, 1
			RCALL DELAY_128US ; DELAY 128US

			CBI LCD, RS ; RS = 0 GHI LENH
			LDI R17, 0XC4 ; CON TRO BAT DAU O DONG 2 VI TRI SO 5
			RCALL CURS_POS
LINE2_1:
			LD R17, -X
			CPI R17, 0X00 ; KIEM TRA CO PHAI KI TU KET THUC HAY KHONG
			BREQ STOP_1 ; NEU LA KI TU KET THUC, NHAY TOI STOP_1
			LDI R16, 1
			RCALL DELAY_128US
			SBI LCD, RS ; RS = 1 GHI LENH
			RCALL OUT_LCD ; XUAT RA LCD
			RJMP LINE2_1 ; HIEN THI TIEP DONG 2 CUA LCD
STOP_1:
			LDI R16, 1
			RCALL DELAY_128US

			RETI


;------------------------------------------------------------------------------------------------------
; INT2_ISR NGAT KHI PB2 (SW2) TAC DONG CANH XUONG (SW DUOC NHAN)
; KHI CO YEU CAU THUC HIEN NGAT INT2 O SWITCH 2, TRUYEN RA HERCULES GIA TIEN THUC TE
; "THANH TIEN: HIJ.KLM USD"
; VOI HIJ.KLM LA GIA TIEN THUC TE

INT2_ISR:
			LDI DATA_TRANS, 'T' ; LAY MA ASCII CUA CHU T
			RCALL USART_TRANS ; TRUYEN LEN HERCULES

			LDI DATA_TRANS, 'H' ; LAY MA ASCII CUA CHU H
			RCALL USART_TRANS ; TRUYEN LEN HERCULES

			LDI DATA_TRANS, 'A' ; LAY MA ASCII CUA CHU A
			RCALL USART_TRANS ; TRUYEN LEN HERCULES

			LDI DATA_TRANS, 'N' ; LAY MA ASCII CUA CHU N
			RCALL USART_TRANS ; TRUYEN LEN HERCULES

			LDI DATA_TRANS, 'H' ; LAY MA ASCII CUA CHU H
			RCALL USART_TRANS ; TRUYEN LEN HERCULES

			LDI DATA_TRANS, 0X20 ; LAY MA ASCII CUA KHOANG TRANG
			RCALL USART_TRANS ; TRUYEN LEN HERCULES

			LDI DATA_TRANS, 'T' ; LAY MA ASCII CUA CHU T
			RCALL USART_TRANS ; TRUYEN LEN HERCULES

			LDI DATA_TRANS, 'I' ; LAY MA ASCII CUA CHU I
			RCALL USART_TRANS ; TRUYEN LEN HERCULES

			LDI DATA_TRANS, 'E' ; LAY MA ASCII CUA CHU E
			RCALL USART_TRANS ; TRUYEN LEN HERCULES

			LDI DATA_TRANS, 'N' ; LAY MA ASCII CUA CHU N
			RCALL USART_TRANS ; TRUYEN LEN HERCULES

			LDI DATA_TRANS, ':' ; LAY MA ASCII CUA KI TU ':'
			RCALL USART_TRANS ; TRUYEN LEN HERCULES

			LDI DATA_TRANS, 0X20 ; LAY MA ASCII CUA KHOANG TRANG
			RCALL USART_TRANS ; TRUYEN LEN HERCULES

			LDI R16, 7 ; LAY 7 KI TU HIJ.KLM: 'H', 'I', 'J', '.', 'K', 'L', 'M' VOI HIJ.KLM LA GIA TIEN THUC TE
			LDI XH, HIGH(PAY_ADR + 8) ; KI TU DAU TIEN LA 'H' DUOC LUU O PAY_ADR + 7 (0X247)
			LDI XL, LOW(PAY_ADR + 8) ; DAT CON TRO O PAY_ADR + 8 (0X248)

LOOP1:
			LD DATA_TRANS, -X
			RCALL USART_TRANS ; TRUYEN 7 KI TU CUA GIA TIEN THUC TE LEN HERCULES
			DEC R16
			BRNE LOOP1

			LDI DATA_TRANS, 0X20 ; LAY MA ASCII CUA KHOANG TRANG
			RCALL USART_TRANS ; TRUYEN LEN HERCULES

			LDI DATA_TRANS, 'U' ; LAY MA ASCII CUA CHU U
			RCALL USART_TRANS ; TRUYEN LEN HERCULES

			LDI DATA_TRANS, 'S' ; LAY MA ASCII CUA CHU S
			RCALL USART_TRANS ; TRUYEN LEN HERCULES

			LDI DATA_TRANS, 'D' ; LAY MA ASCII CUA CHU D
			RCALL USART_TRANS ; TRUYEN LEN HERCULES

			LDI DATA_TRANS, 0X0D ; LAY MA ASCII CUA KI TU XUONG DONG
			RCALL USART_TRANS ; TRUYEN LEN HERCULES

			RETI




